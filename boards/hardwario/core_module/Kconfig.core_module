## boards/hardwario/twr_core_module/board.yml
```yaml
board:
  name: twr_core_module
  vendor: hardwario
  socs:
    - name: stm32l083xx
```

## boards/hardwario/twr_core_module/twr_core_module_defconfig
```kconfig
CONFIG_SERIAL=y
CONFIG_UART_INTERRUPT_DRIVEN=y
CONFIG_CONSOLE=y
CONFIG_UART_CONSOLE=y
CONFIG_LOG_BACKEND_SHOW_COLOR=n

CONFIG_GPIO=y
CONFIG_CLOCK_CONTROL=y
```

## drivers/atsha204/Kconfig
```kconfig
config ATSHA204
	bool "atsha204"
	depends on I2C

if ATSHA204

module = ATSHA204
module-str = atsha204
source "subsys/logging/Kconfig.template.log_config"

config ATSHA204_INIT_PRIORITY
	int "atsha204 Initialization priority"
	default 90
	help
	  System initialization priority for atsha204 drivers.

endif # ATSHA204
```

## drivers/spirit1/Kconfig
```kconfig
config SPIRIT1
	bool "Spirit1"
	select EVENTS
	depends on GPIO
	depends on SPI

if SPIRIT1

module = SPIRIT1
module-str = spirit1
source "subsys/logging/Kconfig.template.log_config"

config SPIRIT1_INIT_PRIORITY
	int "Spirit1 Initialization priority"
	default 90
	help
	  System initialization priority for Spirit1 drivers.


endif # SPIRIT1
```

## dts/bindings/microchip/microchip,atsha204.yaml
```yaml
description: Microchip ATSHA204

compatible: "microchip,atsha204"

include: [i2c-device.yaml]
```

## dts/bindings/st/st,spirit1.yaml
```yaml
description: ST Spirit1

compatible: "st,spirit1"

include: [spi-device.yaml]

properties:
  irq-gpios:
    type: phandle-array
    required: true
  sdn-gpios:
    type: phandle-array
    required: true
```

## subsys/Kconfig
```kconfig
menu "Subsystems"

rsource "twr_radio/Kconfig"
rsource "twr_dice/Kconfig"

endmenu
```

## subsys/twr_dice/Kconfig
```kconfig
config TWR_DICE
	bool "TWR_DICE"
	
if TWR_DICE

module = TWR_DICE
module-str = Tower Dice
source "subsys/logging/Kconfig.template.log_config"

endif # TWR_RADIO
```

## subsys/twr_radio/Kconfig
```kconfig
config TWR_RADIO
	bool "TWR_RADIO"
	
if TWR_RADIO

module = TWR_RADIO
module-str = Tower Radio Protocol
source "subsys/logging/Kconfig.template.log_config"

config TWR_RADIO_SHELL
	bool "Enable TWR_RADIO shell"
	default y
	depends on SHELL && TWR_RADIO
	
choice
	prompt "Radio band"
	
config TWR_RADIO_BAND_868
	bool "868 MHz"

config TWR_RADIO_BAND_915
	bool "915 MHz"
	
endchoice

endif # TWR_RADIO
```

## west.yml
```yaml
manifest:
  self:
    path: twr
  projects:
    - name: zephyr
      url: https://github.com/marekmaskarinec/zephyr
      revision: main
      import:
        name-allowlist:
          - hal_stm32
```
