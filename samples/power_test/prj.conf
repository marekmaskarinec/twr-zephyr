## prj.conf
```kconfig
CONFIG_GPIO=y
CONFIG_EVENTS=y
CONFIG_LOG=y
CONFIG_LOG_BACKEND_UART_ASYNC=y

CONFIG_PM=y
CONFIG_PM_DEVICE=y
```

## src/main.c
```c
/*
 * Copyright (c) 2016 Intel Corporation
 *
 * SPDX-License-Identifier: Apache-2.0
 */

#include <stdio.h>
#include <zephyr/kernel.h>
#include <zephyr/device.h>
#include <zephyr/drivers/gpio.h>
#include <drivers/atsha204.h>
#include <zephyr/logging/log.h>

LOG_MODULE_REGISTER(main, LOG_LEVEL_INF);

int main(void)
{
	while (true) {
		int64_t s = k_uptime_get();
		while (k_uptime_get() - s < 2000)
			;

		k_msleep(2000);
	}
}
```
