## CMakeLists.txt
```
# SPDX-License-Identifier: Apache-2.0

cmake_minimum_required(VERSION 3.20.0)
find_package(Zephyr REQUIRED HINTS $ENV{ZEPHYR_BASE})
project(push_button)

target_sources(app PRIVATE src/accel.c)
target_sources(app PRIVATE src/battery.c)
target_sources(app PRIVATE src/button.c)
target_sources(app PRIVATE src/led.c)
target_sources(app PRIVATE src/main.c)
target_sources(app PRIVATE src/therm.c)
```

## Kconfig
```
menu "Application"

config FW_NAME
	string "Firmware Name"
	default "push-button"

config FW_VERSION
	string "Firmware Version"
	default "v1.0.0"

endmenu

menu "Zephyr Kernel"
source "Kconfig.zephyr"
endmenu
```

## prj.conf
```kconfig
CONFIG_GPIO=y
CONFIG_EVENTS=y
CONFIG_SPI=y
CONFIG_SPIRIT1=y
CONFIG_LOG=y
CONFIG_LOG_BACKEND_UART_ASYNC=y
CONFIG_TWR_RADIO=y
CONFIG_I2C=y
CONFIG_ATSHA204=y
CONFIG_SENSOR=y
CONFIG_CBPRINTF_FP_SUPPORT=y

CONFIG_TWR_DICE=y
CONFIG_LIS2DH_OPER_MODE_LOW_POWER=y
CONFIG_LIS2DH_ODR_1=y
CONFIG_LIS2DH_MEASURE_TEMPERATURE=n
CONFIG_LIS2DH_TRIGGER_GLOBAL_THREAD=y
```

## app.overlay
```dts
/ {
	aliases {
		sw0 = &button0;
	};
};
```

## src/main.c
```c
#include <stdio.h>
#include <zephyr/kernel.h>
#include <zephyr/device.h>
#include <zephyr/drivers/gpio.h>
#include <zephyr/logging/log.h>

#include <twr/twr_radio.h>

#include "button.h"
#include "led.h"
#include "therm.h"
#include "accel.h"

LOG_MODULE_REGISTER(main, LOG_LEVEL_INF);

int send_pairing(void)
{
	struct twr_radio_msg msg = {
		.header = TWR_RADIO_HEADER_PAIRING,
		.type = TWR_RADIO_MSG_TYPE_PUB,
	};

	memset(msg.pub.data, 0, sizeof(msg.pub.data));
	msg.pub.data[0] = strlen(CONFIG_FW_NAME);
	strcpy(&msg.pub.data[1], CONFIG_FW_NAME);
	strcpy(&msg.pub.data[1 + strlen(CONFIG_FW_NAME) + 1], CONFIG_FW_VERSION);
	msg.pub.data_len = 1 + strlen(CONFIG_FW_NAME) + 1 + strlen(CONFIG_FW_VERSION) + 1;

	int ret = twr_radio_pub(&msg, K_MSEC(1000));
	if (ret) {
		LOG_ERR("Call `twr_radio_pub` failed: %d", ret);
		return ret;
	}

	return 0;
}

int main(void)
{
	int ret;

	ret = led_init();
	if (ret) {
		LOG_ERR("Call `led_init` failed: %d", ret);
		return ret;
	}

	led_set(1);

	ret = send_pairing();
	if (ret) {
		LOG_ERR("Call `send_pairing` failed: %d", ret);
		return ret;
	}

	ret = therm_init();
	if (ret) {
		LOG_ERR("Call `therm_init` failed: %d", ret);
		return ret;
	}

	ret = accel_init();
	if (ret) {
		LOG_ERR("Call `accel_init` failed: %d", ret);
		return ret;
	}

	ret = button_init();
	if (ret) {
		LOG_ERR("Call `button_init` failed: %d", ret);
		return ret;
	}

	led_set(0);

	while (true) {
		LOG_INF("Alive!");
		k_sleep(K_SECONDS(5));
	}
}
```

## src/accel.c
```c
#include <stdio.h>
#include <zephyr/kernel.h>
#include <zephyr/device.h>
#include <zephyr/drivers/sensor.h>
#include <zephyr/logging/log.h>
#include <zephyr/sys/byteorder.h>

#include <twr/twr_dice.h>
#include <twr/twr_radio.h>

#include "accel.h"

LOG_MODULE_REGISTER(accel, LOG_LEVEL_INF);

static const struct device *m_dev = DEVICE_DT_GET_ANY(st_lis2dh);
static struct twr_dice m_dice;

static void trigger_handler(const struct device *dev, const struct sensor_trigger *trig)
{
	int ret;

	ret = sensor_sample_fetch(m_dev);
	if (ret) {
		LOG_ERR("Call `sensor_sample_fetch` failed: %d", ret);
		return;
	}

	struct sensor_value accel[3];
	ret = sensor_channel_get(m_dev, SENSOR_CHAN_ACCEL_XYZ, accel);
	if (ret) {
		LOG_ERR("Call `sensor_channel_get` failed: %d", ret);
		return;
	}

	double accel_x = sensor_value_to_double(&accel[0]);
	double accel_y = sensor_value_to_double(&accel[1]);
	double accel_z = sensor_value_to_double(&accel[2]);

	enum twr_dice_face last_face = twr_dice_get_face(&m_dice);
	twr_dice_feed_vectors(&m_dice, accel_x, accel_y, accel_z);
	enum twr_dice_face face = twr_dice_get_face(&m_dice);
	if (last_face == face) {
		return;
	}

	LOG_INF("Orientation changed to %d", face);

	static struct twr_radio_msg msg;
	memset(&msg, 0, sizeof(struct twr_radio_msg));
	msg.type = TWR_RADIO_MSG_TYPE_PUB;
	msg.header = TWR_RADIO_HEADER_PUB_TOPIC_INT;
	int32_t face_le = sys_cpu_to_le32(face);
	memcpy(msg.pub.data, &face_le, sizeof(face_le));
	static const char topic[] = "orientation";
	memcpy(msg.pub.data + sizeof(int32_t), topic, sizeof(topic));
	msg.pub.data_len = sizeof(int32_t) + sizeof(topic);

	ret = twr_radio_pub(&msg, K_MSEC(1000));
	if (ret) {
		LOG_ERR("Call `twr_radio_pub` failed: %d", ret);
	}
}

int accel_init(void)
{
	int ret;

	if (!device_is_ready(m_dev)) {
		return -ENODEV;
	}

	struct sensor_trigger trig;
	trig.type = SENSOR_TRIG_DATA_READY;
	trig.chan = SENSOR_CHAN_ACCEL_XYZ;

	ret = sensor_trigger_set(m_dev, &trig, trigger_handler);
	if (ret) {
		LOG_ERR("Call `sensor_trigger_set` failed: %d", ret);
		return ret;
	}

	twr_dice_init(&m_dice, TWR_DICE_FACE_UNKNOWN);

	return 0;
}
```

## src/accel.h
```c
#ifndef ACCEL_H_
#define ACCEL_H_

int accel_init(void);

#endif /* ACCEL_H_ */
```

## src/battery.h
```c
#ifndef BATTERY_H_
#define BATTERY_H_

int battery_init(void);

#endif /* BATTERY_H_ */
```

## src/button.c
```c
#include <zephyr/kernel.h>
#include <zephyr/device.h>
#include <zephyr/drivers/gpio.h>
#include <zephyr/logging/log.h>
#include <zephyr/sys/byteorder.h>

#include <twr/twr_radio.h>

#include <stdint.h>

#include "led.h"

LOG_MODULE_REGISTER(button, LOG_LEVEL_INF);

#define DEBOUNCE_TIMEOUT_MS 20

static const struct gpio_dt_spec m_sw0 = GPIO_DT_SPEC_GET(DT_ALIAS(sw0), gpios);
static struct gpio_callback m_sw0_cb;

static uint16_t m_count = 0;

void button_work_handler(struct k_work *work)
{
	m_count++;
	LOG_INF("Button clicked %d", m_count);
	led_blink(K_MSEC(30));

	static struct twr_radio_msg msg;
	memset(&msg, 0, sizeof(struct twr_radio_msg));
	msg.type = TWR_RADIO_MSG_TYPE_PUB;
	msg.header = TWR_RADIO_HEADER_PUB_EVENT_COUNT;
	msg.pub.data[0] = TWR_RADIO_PUB_EVENT_PUSH_BUTTON;
	uint16_t count_le = sys_cpu_to_le16(m_count);
	memcpy(msg.pub.data + 1, &count_le, sizeof(count_le));
	msg.pub.data_len = 1 + sizeof(count_le);

	int ret = twr_radio_pub(&msg, K_MSEC(1000));
	if (ret) {
		LOG_ERR("Call `twr_radio_pub` failed: %d", ret);
	}
}

static K_WORK_DEFINE(m_button_work, button_work_handler);

void debounce_timer_handler(struct k_timer *timer)
{
	k_work_submit(&m_button_work);
}

static K_TIMER_DEFINE(m_debounce_timer, debounce_timer_handler, NULL);

void sw0_cb_handler(const struct device *dev, struct gpio_callback *cb, uint32_t pins)
{
	if (!gpio_pin_get_dt(&m_sw0)) {
		k_timer_start(&m_debounce_timer, K_MSEC(DEBOUNCE_TIMEOUT_MS), K_FOREVER);
	} else {
		k_timer_stop(&m_debounce_timer);
	}
}

int button_init(void)
{
	int ret;

	ret = gpio_pin_configure_dt(&m_sw0, GPIO_INPUT);
	if (ret) {
		LOG_ERR("Call `gpio_pin_configure_dt` failed: %d", ret);
		return ret;
	}

	ret = gpio_pin_interrupt_configure_dt(&m_sw0,
					      GPIO_INT_EDGE_TO_ACTIVE | GPIO_INT_EDGE_TO_INACTIVE);
	if (ret) {
		LOG_ERR("Call `gpio_pin_interrupt_configure_dt` failed: %d", ret);
		return ret;
	}

	gpio_init_callback(&m_sw0_cb, sw0_cb_handler, BIT(m_sw0.pin));
	ret = gpio_add_callback_dt(&m_sw0, &m_sw0_cb);
	if (ret) {
		LOG_ERR("Call `gpio_add_callback_dt` failed: %d", ret);
		return ret;
	}

	return 0;
}
```

## src/button.h
```c
#ifndef BUTTON_H_
#define BUTTON_H_

int button_init();

#endif /* BUTTON_H_ */
```

## src/led.c
```c
#include <zephyr/kernel.h>
#include <zephyr/device.h>
#include <zephyr/drivers/gpio.h>
#include <zephyr/logging/log.h>

#include "led.h"

LOG_MODULE_REGISTER(led, LOG_LEVEL_INF);

static const struct gpio_dt_spec m_led0 = GPIO_DT_SPEC_GET(DT_ALIAS(led0), gpios);

int led_set(int value)
{
	return gpio_pin_set_dt(&m_led0, value);
}

int led_blink(k_timeout_t delay)
{
	int ret;

	ret = led_set(1);
	if (ret) {
		LOG_ERR("Call `led_set` failed: %d", ret);
		return ret;
	}

	k_sleep(delay);

	ret = led_set(0);
	if (ret) {
		LOG_ERR("Call `led_set` failed: %d", ret);
		return ret;
	}

	return 0;
}

int led_init(void)
{
	int ret;

	ret = gpio_pin_configure_dt(&m_led0, GPIO_OUTPUT);
	if (ret) {
		LOG_ERR("Call `gpio_pin_configure_dt` failed: %d", ret);
		return ret;
	}

	return 0;
}
```

## src/led.h
```c
#ifndef LED_H_
#define LED_H_

int led_set(int value);
int led_blink(k_timeout_t delay);
int led_init(void);

#endif /* LED_H_ */
```

## src/therm.c
```c
#include <zephyr/kernel.h>
#include <zephyr/drivers/sensor.h>
#include <zephyr/device.h>
#include <zephyr/logging/log.h>

#include <twr/twr_radio.h>

#include "therm.h"

LOG_MODULE_REGISTER(therm, LOG_LEVEL_INF);

const struct device *const m_tmp112 = DEVICE_DT_GET_ANY(ti_tmp112);

static int send(struct sensor_value *val)
{
	static struct twr_radio_msg msg;
	memset(&msg, 0, sizeof(struct twr_radio_msg));
	msg.type = TWR_RADIO_MSG_TYPE_PUB;
	msg.header = TWR_RADIO_HEADER_PUB_TEMPERATURE;
	msg.pub.data[0] = 0; // channel 0
	float temp = sensor_value_to_double(val);
	memcpy(msg.pub.data + 1, &temp, sizeof(temp));
	msg.pub.data_len = 1 + sizeof(temp);

	return twr_radio_pub(&msg, K_MSEC(1000));
}

static int sample(struct sensor_value *val)
{
	int ret;

	ret = sensor_sample_fetch(m_tmp112);
	if (ret) {
		printk("sensor_sample_fetch failed ret %d\n", ret);
		return ret;
	}

	ret = sensor_channel_get(m_tmp112, SENSOR_CHAN_AMBIENT_TEMP, val);
	if (ret) {
		printk("sensor_channel_get failed ret %d\n", ret);
		return ret;
	}

	return 0;
}

static void therm_work_handler(struct k_work *work)
{
	int ret;
	struct sensor_value val;

	ret = sample(&val);
	if (ret) {
		LOG_INF("sample failed ret %d\n", ret);
		return;
	}

	LOG_INF("Temperature: %d.%06d C\n", val.val1, val.val2);

	ret = send(&val);
	if (ret) {
		LOG_INF("send failed ret %d\n", ret);
		return;
	}
}

static K_WORK_DEFINE(m_therm_work, therm_work_handler);

static void therm_timer_handler(struct k_timer *timer)
{
	k_work_submit(&m_therm_work);
}

static K_TIMER_DEFINE(m_therm_timer, therm_timer_handler, NULL);

int therm_init(void)
{
	int ret;
	struct sensor_value attr;

	attr.val1 = 150;
	attr.val2 = 0;
	ret = sensor_attr_set(m_tmp112, SENSOR_CHAN_AMBIENT_TEMP, SENSOR_ATTR_FULL_SCALE, &attr);
	if (ret) {
		printk("sensor_attr_set failed ret %d\n", ret);
		return ret;
	}

	attr.val1 = 8;
	attr.val2 = 0;
	ret = sensor_attr_set(m_tmp112, SENSOR_CHAN_AMBIENT_TEMP, SENSOR_ATTR_SAMPLING_FREQUENCY,
			      &attr);
	if (ret) {
		printk("sensor_attr_set failed ret %d\n", ret);
		return ret;
	}

	k_timer_start(&m_therm_timer, K_SECONDS(5), K_MINUTES(30));

	return 0;
}
```

## src/therm.h
```c
#ifndef THERM_H_
#define THERM_H_

int therm_init(void);

#endif /* THERM_H_ */
```
